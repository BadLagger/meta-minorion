## conf/layer.conf
```bitbake
BBPATH .= ":${LAYERDIR}"

BBFILES += "${LAYERDIR}/recipes-*/*/*.bb \
            ${LAYERDIR}/recipes-*/*/*.bbappend \
            ${LAYERDIR}/recipes-*/*.bb \
            ${LAYERDIR}/recipes-*/*.bbappend "

BBFILE_COLLECTIONS += "minorion"
BBFILE_PATTERN_minorion = "^${LAYERDIR}/"
BBFILE_PRIORITY_minorion = "5"
LAYERVERSION_minorion = "1"
LAYERSERIES_COMPAT_minorion = "zeus"
```
